## config/west.yml
```yaml
manifest:
  remotes:
    - name: zmkfirmware
      url-base: https://github.com/zmkfirmware
    # nice-view-gem
    - name: m165437
      url-base: https://github.com/M165437
    # Prospector Scanner
    - name: prospector
      url-base: https://github.com/t-ogura
  projects:
    - name: zmk
      remote: zmkfirmware
      revision: v0.3
      import: app/west.yml
    # nice-view-gem
    - name: nice-view-gem
      remote: m165437
      revision: v0.3.0
    # Prospector Scanner
    - name: prospector-zmk-module
      remote: prospector
      revision: v2.0.0
      path: modules/prospector-zmk-module
  self:
    path: config
```
